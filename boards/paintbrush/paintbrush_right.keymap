/*
 * Copyright (c) 2021 Mike "KemoNine" Crosson
 *
 * SPDX-License-Identifier: MIT
 */

#include <behaviors.dtsi>
#include <dt-bindings/zmk/keys.h>
#include <dt-bindings/zmk/bt.h>

// Left/Right
#define ARDUX_RIGHT 1

// ARTS Row
#define KEY_A 0
#define KEY_R 1
#define KEY_T 2
#define KEY_S 3
// EYIO Row
#define KEY_E 4
#define KEY_Y 5
#define KEY_I 6
#define KEY_O 7

// Define Offsets
#define LEADING_NONES NONE(0,0,0)
#define MIDDLE_NONES NONE(0, 0, 0)
#define TRAILING_NONES NONE(0, 0, 0)

// Include main ardux.io keymap
#include "./ardux.dtsi"

// ///

//#include <behaviors.dtsi>
//#include <dt-bindings/zmk/keys.h>
//
/// {
//    behaviors {
//    };
//    keymap {
//        compatible = "zmk,keymap";
//
//        default_layer {
//            bindings = <
//// ╭──────────┬──────────┬──────────┬──────────╮
//      &kp N0     &kp N1     &kp N2     &kp N3
//// ├──────────┼──────────┼──────────┼──────────┤
//      &kp N4     &kp N5     &kp N6     &kp N7
//// ╰──────────┴──────────┴──────────┴──────────╯
//            >;
//        };
//    };
//};
