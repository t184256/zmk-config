/*
 * Copyright (c) 2021 Mike "KemoNine" Crosson
 *
 * SPDX-License-Identifier: MIT
 */

#include <behaviors.dtsi>
#include <dt-bindings/zmk/keys.h>
#include <dt-bindings/zmk/bt.h>

// Left/Right
#define ARDUX_LEFT 1

// ARTS Row
#define KEY_A 3
#define KEY_R 2
#define KEY_T 1
#define KEY_S 0
// EYIO Row
#define KEY_E 7
#define KEY_Y 6
#define KEY_I 5
#define KEY_O 4

// Define Offsets
#define LEADING_NONES NONE(0,0,0)
#define MIDDLE_NONES NONE(0, 0, 0)
#define TRAILING_NONES NONE(0, 0, 0)

// Include main ardux.io keymap
#include "./ardux.dtsi"

// ///

//#include <behaviors.dtsi>
//#include <dt-bindings/zmk/keys.h>
//
/// {
//    behaviors {
//    };
//    keymap {
//        compatible = "zmk,keymap";
//
//        default_layer {
//            bindings = <
//// ╭──────────┬──────────┬──────────┬──────────╮
//      &kp N0     &kp N1     &kp N2     &kp N3
//// ├──────────┼──────────┼──────────┼──────────┤
//      &kp N4     &kp N5     &kp N6     &kp N7
//// ╰──────────┴──────────┴──────────┴──────────╯
//            >;
//        };
//    };
//};
