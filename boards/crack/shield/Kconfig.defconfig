## boards/crack/shield/Kconfig.defconfig
```kconfig
config ZMK_KEYBOARD_NAME
	default "crack"
	# must be less than 16 characters long
```

## boards/crutch/Kconfig
```kconfig
config ZMK_BEHAVIOR_PRESS_RELEASE
	bool "Press-Release behavior"
	default y
	help
	  Enable press-release behavior that can trigger different actions on press and release
```

## boards/crutch/dts/bindings/behaviors/zmk,behavior-press-release.yaml
```yaml
# Copyright (c) 2020 The ZMK Contributors
# SPDX-License-Identifier: MIT

description: |
  Press-Release behavior

  This behavior allows you to trigger one action when a key is pressed
  and a different action when the key is released.

compatible: "zmk,behavior-press-release"

include: base.yaml

binding-cells:
  - param1
  - param2
```

## boards/crutch/shield/Kconfig.defconfig
```kconfig
config ZMK_KEYBOARD_NAME
	# must be less than 16 characters long
	default "crutch"
```

## boards/paintbrush/shield/Kconfig.shield
```kconfig
config SHIELD_PAINTBRUSH_LEFT
	def_bool $(shields_list_contains,paintbrush_left)

config SHIELD_PAINTBRUSH_RIGHT
	def_bool $(shields_list_contains,paintbrush_right)
```

## boards/seventeeen/shield/Kconfig.defconfig
```kconfig
if SHIELD_SEVENTEEEN_LEFT

config ZMK_KEYBOARD_NAME
	# must be less than 16 characters long
	default "seventeeen"

config ZMK_SPLIT_ROLE_CENTRAL
	default y

endif

if SHIELD_SEVENTEEEN_LEFT || SHIELD_SEVENTEEEN_RIGHT

config ZMK_SPLIT
	default y

endif
```

## boards/seventeeen/shield/Kconfig.shield
```kconfig
config SHIELD_SEVENTEEEN_LEFT
	def_bool $(shields_list_contains,seventeeen_left)

config SHIELD_SEVENTEEEN_RIGHT
	def_bool $(shields_list_contains,seventeeen_right)
```

## config/west.yml
```yaml
manifest:
  remotes:
    - name: zmkfirmware
      url-base: https://github.com/zmkfirmware
    - name: caksoylar
      url-base: https://github.com/caksoylar
    - name: t184256
      url-base: https://github.com/t184256
  projects:
    - name: zephyr
      remote: zmkfirmware
      revision: dacab4875df72109b96cc8977547a0dc04875bcd  # v3.5.0+zmk-fixes
      import:
        name-blocklist:
          - ci-tools
          - hal_altera
          - hal_cypress
          - hal_infineon
          - hal_microchip
          - hal_nxp
          - hal_openisa
          - hal_silabs
          - hal_xtensa
          - hal_st
          - hal_ti
          - loramac-node
          - mcuboot
          - mcumgr
          - net-tools
          - openthread
          - edtt
          - trusted-firmware-m
    - name: zmk
      remote: zmkfirmware
      revision: e34793e8c7193bc868b95ec38d78f67956f759cb  # 
      import: app/west.yml
    - name: zmk-rgbled-widget
      remote: caksoylar
      revision: fbe6dde8ffa68fdcded1600a66aa18cf12a796fb  # 
    - name: zmk-engine
      remote: t184256
      revision: 6f95ff6f3feaecbc586fa1ca03ce8626c545f121  # main
  self:
    path: config
```
